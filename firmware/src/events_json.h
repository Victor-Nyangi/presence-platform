// events_json.h — the events batch payload and the responses that come back.
//
// Deliberately free of Arduino headers, for the same reason canonical.h is:
// this is protocol-critical code, and a disagreement with the gateway does
// not announce itself. A misspelled enum or a missing field does not throw —
// the punch is simply stored as `malformed` or resolves to nobody, and you
// find out from an attendance report weeks later. So the wire shape is
// pinned by host tests instead of trusted.
//
// The mirror on the server side is gateway/internal/model/model.go. If you
// change a field here, change it there, and change docs/openapi.yaml.
#pragma once

#include <stdint.h>

#include <string>

#include "ring_buffer.h"

namespace presence {

// BatchMeta carries the envelope fields that are properties of the UPLOAD
// rather than of any single punch. deviceUptimeMs in particular is not
// optional in practice: it is the only thing that lets the gateway rebuild
// wall time for events captured while the RTC was dead
// (received_at - (deviceUptimeMs - capturedUptimeMs)).
struct BatchMeta {
  std::string requestId;     // UUID; generated by the caller, which owns the RNG
  uint64_t deviceUptimeMs;   // uptime at the moment of upload
  size_t bufferDepth;        // unacknowledged records still held
};

// ---------------------------------------------------------------------
// Time
// ---------------------------------------------------------------------

// appendPadded writes v as exactly `width` digits, truncating from the left
// if it somehow does not fit. Callers clamp their inputs so that cannot
// happen; this is the belt to that pair of braces.
inline void appendPadded(std::string& out, int64_t v, int width) {
  if (v < 0) v = 0;
  char digits[20];
  int n = 0;
  do {
    digits[n++] = static_cast<char>('0' + (v % 10));
    v /= 10;
  } while (v != 0 && n < static_cast<int>(sizeof(digits)));
  for (int pad = n; pad < width; pad++) out.push_back('0');
  while (n > 0) out.push_back(digits[--n]);
}

// formatRfc3339Utc renders epoch milliseconds as the gateway's Go decoder
// expects. Hand-rolled rather than gmtime-based so it behaves identically on
// the host and on the ESP32, with no locale, no TZ database and no reliance
// on newlib's 64-bit time support.
//
// The civil-from-days conversion is Howard Hinnant's, with the year origin
// shifted to March so leap days fall at the end of the cycle and no special
// case is needed for them.
inline std::string formatRfc3339Utc(int64_t epochMs) {
  if (epochMs < 0) epochMs = 0;

  int64_t days = epochMs / 86'400'000;
  int64_t msOfDay = epochMs % 86'400'000;

  int64_t z = days + 719'468;
  const int64_t era = (z >= 0 ? z : z - 146'096) / 146'097;
  const int64_t doe = z - era * 146'097;                                        // [0, 146096]
  const int64_t yoe = (doe - doe / 1460 + doe / 36'524 - doe / 146'096) / 365;  // [0, 399]
  const int64_t doy = doe - (365 * yoe + yoe / 4 - yoe / 100);                  // [0, 365]
  const int64_t mp = (5 * doy + 2) / 153;                                       // [0, 11]

  const int64_t day = doy - (153 * mp + 2) / 5 + 1;
  const int64_t month = mp + (mp < 10 ? 3 : -9);
  int64_t year = yoe + era * 400 + (month <= 2 ? 1 : 0);

  // Pin the year to four digits. A device whose RTC returns garbage would
  // otherwise produce a timestamp too long for the buffer below, and a
  // truncated timestamp is a malformed event rather than a loud failure.
  // Postgres cannot store a year outside this range either.
  if (year < 0) year = 0;
  if (year > 9999) year = 9999;

  const int64_t hour = msOfDay / 3'600'000;
  const int64_t minute = (msOfDay / 60'000) % 60;
  const int64_t second = (msOfDay / 1000) % 60;
  const int64_t milli = msOfDay % 1000;

  // Digits are emitted by hand rather than with snprintf. Two reasons, and
  // the second is the load-bearing one:
  //
  //   - the width of every field is then provable at compile time, so this
  //     cannot silently truncate a timestamp into a malformed event;
  //   - ESP-IDF links newlib-nano by default, whose printf does NOT handle
  //     %lld unless a sdkconfig option is turned on. A format this code
  //     depends on has no business being a build-configuration question.
  std::string out;
  out.reserve(24);
  appendPadded(out, year, 4);
  out.push_back('-');
  appendPadded(out, month, 2);
  out.push_back('-');
  appendPadded(out, day, 2);
  out.push_back('T');
  appendPadded(out, hour, 2);
  out.push_back(':');
  appendPadded(out, minute, 2);
  out.push_back(':');
  appendPadded(out, second, 2);
  out.push_back('.');
  appendPadded(out, milli, 3);
  out.push_back('Z');
  return out;
}

// formatUuid renders 16 raw bytes as 8-4-4-4-12 lowercase hex. Postgres will
// reject anything else, and the rejection surfaces as a 500 on ingest rather
// than as a per-event rejection, so it is worth getting right.
inline std::string formatUuid(const uint8_t uuid[16]) {
  static const char* kHex = "0123456789abcdef";
  std::string out;
  out.reserve(36);
  for (int i = 0; i < 16; i++) {
    if (i == 4 || i == 6 || i == 8 || i == 10) out.push_back('-');
    out.push_back(kHex[uuid[i] >> 4]);
    out.push_back(kHex[uuid[i] & 0x0F]);
  }
  return out;
}

// ---------------------------------------------------------------------
// Enum codes -> the spellings in db/001_schema.sql
//
// PunchRecord stores these as single bytes to keep the flash record at 60
// bytes. The mapping back to strings lives here, and only here.
// ---------------------------------------------------------------------

inline const char* credentialKindName(uint8_t code) {
  switch (code) {
    case 0: return "fingerprint";
    case 1: return "rfid_card";
    case 2: return "nfc_tag";
    case 3: return "pin";
    case 4: return "qr";
    default: return "fingerprint";
  }
}

inline const char* timeSourceName(uint8_t code) {
  switch (code) {
    case 0: return "rtc_synced";
    case 1: return "rtc_unsynced";
    case 2: return "uptime_only";
    // No usable device time at all. The gateway stamps it on arrival and
    // marks the confidence low.
    default: return "server_assigned";
  }
}

inline const char* directionHintName(uint8_t code) {
  switch (code) {
    case 1: return "in";
    case 2: return "out";
    default: return "unknown";
  }
}

// ---------------------------------------------------------------------
// Serialisation
// ---------------------------------------------------------------------

inline std::string jsonInt(int64_t v) {
  if (v == 0) return "0";
  const bool negative = v < 0;
  // Accumulate on the negative side so INT64_MIN does not overflow when
  // negated. Every value this firmware emits is non-negative, but a helper
  // that quietly corrupts one input is not worth keeping.
  char tmp[20];
  size_t n = 0;
  int64_t x = negative ? v : -v;
  while (x != 0 && n < sizeof(tmp)) {
    tmp[n++] = static_cast<char>('0' - (x % 10));
    x /= 10;
  }
  std::string out;
  out.reserve(n + 1);
  if (negative) out.push_back('-');
  while (n > 0) out.push_back(tmp[--n]);
  return out;
}

// buildEventsJson renders a peeked batch as a POST /v1/device/events body.
//
// No escaping is performed and none is needed: every string emitted here is
// either a fixed enum spelling, hex from formatUuid, or a formatted
// timestamp. requestId is the one caller-supplied value, and it is a UUID.
// If a free-text field is ever added, this needs a real escaper first.
//
// LIMITATION: PunchRecord has no room for a credential_ref, so non-biometric
// credentials (cards, tags, PINs) cannot round-trip through the offline
// buffer yet — the gateway resolves those by hashed reference, not slot.
// Adding one means spending some of PunchRecord::reserved and bumping the
// record format.
inline std::string buildEventsJson(const PunchRecord* batch, size_t n, const BatchMeta& meta) {
  std::string out;
  out.reserve(128 + n * 256);

  out += "{\"request_id\":\"";
  out += meta.requestId;
  out += "\",\"device_uptime_ms\":";
  out += jsonInt(static_cast<int64_t>(meta.deviceUptimeMs));
  out += ",\"buffer_depth\":";
  out += jsonInt(static_cast<int64_t>(meta.bufferDepth));
  out += ",\"events\":[";

  for (size_t i = 0; i < n; i++) {
    const PunchRecord& r = batch[i];
    if (i > 0) out += ',';

    out += "{\"seq\":";
    out += jsonInt(static_cast<int64_t>(r.seq));
    out += ",\"event_uuid\":\"";
    out += formatUuid(r.uuid);
    out += '"';

    // Omitted entirely when the RTC never gave us a usable reading. Go
    // decodes the absent key as a zero time.Time, which the gateway replaces
    // with the time it reconstructs from the uptime delta. Sending
    // 1970-01-01 instead would record a decades-long clock skew and drag the
    // event into the review queue for no reason.
    if (r.capturedEpochMs > 0) {
      out += ",\"captured_at\":\"";
      out += formatRfc3339Utc(static_cast<int64_t>(r.capturedEpochMs));
      out += '"';
    }
    if (r.capturedUptimeMs > 0) {
      out += ",\"captured_uptime_ms\":";
      out += jsonInt(static_cast<int64_t>(r.capturedUptimeMs));
    }

    out += ",\"time_source\":\"";
    out += timeSourceName(r.timeSource);
    out += "\",\"credential_kind\":\"";
    out += credentialKindName(r.credentialKind);
    out += '"';

    if (r.slotNo > 0) {
      out += ",\"slot_no\":";
      out += jsonInt(r.slotNo);
    }
    if (r.matchScore > 0) {
      out += ",\"match_score\":";
      out += jsonInt(r.matchScore);
    }

    // Only ever a hint. The gateway computes the canonical direction from
    // the person's prior state, because a bidirectional reader cannot know.
    out += ",\"direction_hint\":\"";
    out += directionHintName(r.directionHint);
    out += "\"}";
  }

  out += "]}";
  return out;
}

// ---------------------------------------------------------------------
// Response parsing
// ---------------------------------------------------------------------

// parseJsonInt extracts a non-negative integer by key from a flat JSON
// object. Purpose-built rather than a parser: the two responses this
// firmware reads have a known shape, and an ESP32 does not need a general
// JSON engine to find one number.
//
// Matching requires the key to be a complete quoted token followed by a
// colon, so "last_ack_through_seen" does not satisfy a search for
// "ack_through", and neither does the name appearing as a string VALUE.
inline bool parseJsonInt(const char* json, const char* key, int64_t* out) {
  if (json == nullptr || key == nullptr || out == nullptr) return false;
  const std::string hay(json);
  const std::string needle = std::string("\"") + key + "\"";

  size_t pos = 0;
  while ((pos = hay.find(needle, pos)) != std::string::npos) {
    size_t i = pos + needle.size();
    while (i < hay.size() && (hay[i] == ' ' || hay[i] == '\t' || hay[i] == '\n' || hay[i] == '\r')) i++;
    if (i >= hay.size() || hay[i] != ':') {
      // The token appeared as a value, not as a key. Keep looking.
      pos += needle.size();
      continue;
    }
    i++;
    while (i < hay.size() && (hay[i] == ' ' || hay[i] == '\t' || hay[i] == '\n' || hay[i] == '\r')) i++;

    bool negative = false;
    if (i < hay.size() && (hay[i] == '-' || hay[i] == '+')) {
      negative = hay[i] == '-';
      i++;
    }
    if (i >= hay.size() || hay[i] < '0' || hay[i] > '9') return false;

    int64_t value = 0;
    while (i < hay.size() && hay[i] >= '0' && hay[i] <= '9') {
      value = value * 10 + (hay[i] - '0');
      i++;
    }
    *out = negative ? -value : value;
    return true;
  }
  return false;
}

// parseAckThrough returns the highest sequence the server durably stored, or
// -1 when the response does not carry one.
//
// -1 rather than 0 matters: 0 is a legitimate value meaning "nothing
// acknowledged", and a caller that cannot tell the two apart would truncate
// its buffer on a malformed response.
inline int64_t parseAckThrough(const char* json) {
  int64_t v = 0;
  if (!parseJsonInt(json, "ack_through", &v)) return -1;
  return v;
}

}  // namespace presence
